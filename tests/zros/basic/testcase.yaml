## tests/zros/basic/testcase.yaml
```yaml
common:
  tags:
    - zros
    - pubsub
  timeout: 20

tests:
  zros.basic:
    tags:
      - smoke
    integration_platforms:
      - native_sim
    platform_allow:
      - native_sim

  zros.basic.high_tick_rate:
    integration_platforms:
      - native_sim
    platform_allow:
      - native_sim
    extra_configs:
      - CONFIG_SYS_CLOCK_TICKS_PER_SEC=100000

  zros.basic.mr_vmu_tropic:
    tags:
      - smoke
      - board
    platform_allow:
      - mr_vmu_tropic/mimxrt1064
```

## tests/zros/stress/testcase.yaml
```yaml
common:
  tags:
    - zros
    - benchmark
    - stress
  harness: console
  harness_config:
    type: one_line
    record:
      regex:
        - "ZROS_BENCH backend=(?P<backend>\\S+) metric=(?P<metric>\\S+) bytes=(?P<bytes>\\d+) readers=(?P<readers>\\d+) subs=(?P<subs>\\d+) avg_ns=(?P<avg_ns>\\d+) min_ns=(?P<min_ns>\\d+) max_ns=(?P<max_ns>\\d+) iterations=(?P<iterations>\\d+) errors=(?P<errors>\\d+) aux_ops=(?P<aux_ops>\\d+)"
    regex:
      - "ZROS_STRESS_DONE"
  timeout: 120

tests:
  zros.stress.native_sim:
    tags:
      - quick
    integration_platforms:
      - native_sim
    platform_allow:
      - native_sim

  zros.stress.native_sim.large_payload:
    tags:
      - payload
    integration_platforms:
      - native_sim
    platform_allow:
      - native_sim
    extra_configs:
      - CONFIG_ZROS_STRESS_PAYLOAD_BYTES=1024
      - CONFIG_ZROS_STRESS_ITERATIONS=10000
      - CONFIG_ZROS_STRESS_CONTENDED_ITERATIONS=3000
      - CONFIG_ZROS_STRESS_MULTI_WRITER_ITERATIONS=3000

  zros.stress.native_sim.smp:
    tags:
      - smp
    integration_platforms:
      - native_sim
    platform_allow:
      - native_sim
    extra_configs:
      - CONFIG_SMP=y
      - CONFIG_MP_MAX_NUM_CPUS=2

  zros.stress.native_sim.forced_overlap:
    tags:
      - overlap
    integration_platforms:
      - native_sim
    platform_allow:
      - native_sim
    extra_configs:
      - CONFIG_SMP=y
      - CONFIG_MP_MAX_NUM_CPUS=2
      - CONFIG_ZROS_STRESS_ITERATIONS=10000
      - CONFIG_ZROS_STRESS_CONTENDED_ITERATIONS=2000
      - CONFIG_ZROS_STRESS_MULTI_WRITER_ITERATIONS=1000
      - CONFIG_ZROS_STRESS_CONTENDED_TIMEOUT_MS=10000
      - CONFIG_ZROS_LOCKLESS_TEST_WRITER_HOLD_YIELDS=32
      - CONFIG_ZROS_LOCKLESS_TEST_READER_PROBE_YIELDS=8

  zros.stress.native_sim.long:
    tags:
      - long
    integration_platforms:
      - native_sim
    platform_allow:
      - native_sim
    extra_configs:
      - CONFIG_ZROS_STRESS_ITERATIONS=100000
      - CONFIG_ZROS_STRESS_CONTENDED_ITERATIONS=20000
      - CONFIG_ZROS_STRESS_MULTI_WRITER_ITERATIONS=20000

  zros.stress.mr_vmu_tropic:
    tags:
      - board
      - quick
    platform_allow:
      - mr_vmu_tropic/mimxrt1064
    timeout: 180
    extra_configs:
      - CONFIG_ZROS_STRESS_ITERATIONS=10000
      - CONFIG_ZROS_STRESS_CONTENDED_ITERATIONS=2000
      - CONFIG_ZROS_STRESS_MULTI_WRITER_ITERATIONS=1000

  zros.stress.mr_vmu_tropic.forced_overlap:
    tags:
      - board
      - overlap
    platform_allow:
      - mr_vmu_tropic/mimxrt1064
    timeout: 180
    extra_configs:
      - CONFIG_ZROS_STRESS_ITERATIONS=5000
      - CONFIG_ZROS_STRESS_CONTENDED_ITERATIONS=1000
      - CONFIG_ZROS_STRESS_MULTI_WRITER_ITERATIONS=500
      - CONFIG_ZROS_STRESS_CONTENDED_TIMEOUT_MS=5000
      - CONFIG_ZROS_LOCKLESS_TEST_WRITER_HOLD_YIELDS=32
      - CONFIG_ZROS_LOCKLESS_TEST_READER_PROBE_YIELDS=8
```

## zephyr/Kconfig
```kconfig
# Copyright (c) 2024, CogniPilot Foundation
# SPDX-License-Identifier: Apache-2.0

config ZROS
  bool "Enables zros"
  select EVENTS
  help
    This option enables zros

if ZROS

config ZROS_SHELL
	bool "Enable zros shell diagnostics"
	depends on SHELL
	help
	  Adds generic broker-backed node and topic shell commands plus optional
	  per-topic pretty-printer registration.

config ZROS_SHELL_THREAD_STACK_SIZE
	int "zros shell watch thread stack size"
	depends on ZROS_SHELL
	default 2048
	range 1024 16384
	help
	  Stack size for the low-priority zros shell echo/hz watcher thread.

config ZROS_SHELL_MAX_TOPIC_SIZE
	int "Maximum topic size for generic zros shell echo"
	depends on ZROS_SHELL
	default 256
	range 32 8192
	help
	  Largest topic payload the generic shell will copy for default echo.
	  Topics larger than this need a registered pretty-printer or a larger
	  buffer.

config ZROS_LOCKLESS_TEST_WRITER_HOLD_YIELDS
	int "Lockless writer hold yields"
	range 0 10000
	default 0
	help
	  Test-only knob. When non-zero, the double-buffer topic backends yield
	  this many times after copying into the inactive buffer and before
	  publishing the new generation. This widens the overlap window for
	  contention benchmarks.

config ZROS_LOCKLESS_TEST_READER_PROBE_YIELDS
	int "Lockless reader probe yields"
	range 0 10000
	default 0
	help
	  Test-only knob. When non-zero, the double-buffer topic backends yield
	  this many times after a reader samples the published generation and
	  before it copies the selected payload slot. This makes it easier to
	  force publish/read overlap in benchmarks.

module = ZROS
module-str = ros
source "subsys/logging/Kconfig.template.log_config"

endif  # ZROS
```
